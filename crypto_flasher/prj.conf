## CMakeLists.txt
```
#-------------------------------------------------------------------------------
# Zephyr Example Application
#
# Copyright (c) 2021 Nordic Semiconductor ASA
# SPDX-License-Identifier: Apache-2.0

cmake_minimum_required(VERSION 3.13.1)
find_package(Zephyr REQUIRED HINTS $ENV{ZEPHYR_BASE})

project(app LANGUAGES C)


function(find_keys_json result_var)
    # Initialize the path variable
    set(current_dir ${CMAKE_CURRENT_SOURCE_DIR})

    # Loop to go upwards until the root directory is reached or file is found
    while(NOT EXISTS "${current_dir}/keys.json")
        # Go one directory up
        get_filename_component(current_dir ${current_dir} DIRECTORY)
        
        # If we reach the root directory (empty current_dir), exit
        if (current_dir STREQUAL "")
            set(${result_var} "" PARENT_SCOPE)  # If not found, set to empty
            return()
        endif()
    endwhile()

    # When found, set the result variable
    set(${result_var} "${current_dir}/keys.json" PARENT_SCOPE)
endfunction()
find_keys_json(KEYS_JSON_PATH)

if(NOT KEYS_JSON_PATH)
    message(FATAL_ERROR "keys.json not found in parent directories.")
else()
    message(STATUS "Found keys.json at: ${KEYS_JSON_PATH}")
endif()

add_custom_command(
    OUTPUT ${CMAKE_SOURCE_DIR}/src/keys.h
    COMMAND west keymgr --cmake-dump ${CMAKE_SOURCE_DIR}/src/keys.h
    DEPENDS ${KEYS_JSON_PATH}
    COMMENT "Dumping device keys into header file"
)

add_custom_target(generate_keys DEPENDS ${CMAKE_SOURCE_DIR}/src/keys.h)
target_sources(app PRIVATE src/main.c)
add_dependencies(app generate_keys)
```

## Kconfig
```
# Copyright (c) 2021 Nordic Semiconductor ASA
# SPDX-License-Identifier: Apache-2.0
#
# This file is the application Kconfig entry point. All application Kconfig
# options can be defined here or included via other application Kconfig files.
# You can browse these options using the west targets menuconfig (terminal) or
# guiconfig (GUI).

menu "Zephyr"
source "Kconfig.zephyr"
endmenu

module = APP
module-str = APP
source "subsys/logging/Kconfig.template.log_config"

config FLASHED_DEVICE
    int "Id of device to flash, 0 means advertiser"
    default -1
```

## prj.conf
```kconfig
# Copyright (c) 2021 Nordic Semiconductor ASA
# SPDX-License-Identifier: Apache-2.0
#
# This file contains selected Kconfig options for the application.

CONFIG_LOG=y

CONFIG_REBOOT=y

CONFIG_NRF_SECURITY=y
CONFIG_BUILD_WITH_TFM=y
CONFIG_TFM_PARTITION_INTERNAL_TRUSTED_STORAGE=y

CONFIG_NET_BUF=y
```

## src/main.c
```c
#include <zephyr/kernel.h>
#include <zephyr/net_buf.h>

#include <app/lib/crypto.h>
#include <app/lib/common.h>
#include "keys.h"

crypto_counter_t counter = {.storage_uid=COUNTER_ID};

BUILD_ASSERT(CONFIG_FLASHED_DEVICE != -1,
             "You need to set id of device to flash");

psa_key_id_t recreate_key(psa_key_id_t id, struct net_buf_simple key) {
    psa_status_t err = psa_destroy_key(id);
    if (err != PSA_SUCCESS && err != PSA_ERROR_INVALID_HANDLE)
        return err;
    return crypto_save_persistent_key(id, &key);
}

int main() {
    k_sleep(K_SECONDS(10));
    if (crypto_init() != 0) {
        printk("Couldn't init crypto");
        goto ret;
    }
    struct net_buf_simple key_buf;
    psa_status_t err;

    printk("Beginning to flash device %d\n", CONFIG_FLASHED_DEVICE);
    err = crypto_secure_counter_init(&counter);
    if (err != PSA_SUCCESS) {
        printk("Failed to init counter %d\n", err);
        goto ret;
    }

    counter.value = 0;
    err = crypto_secure_counter_commit(&counter);
    if (err != PSA_SUCCESS) {
        printk("Failed to commit counter\n");
        goto ret;
    }
    printk("Successfully flashed counter\n");

#if CONFIG_FLASHED_DEVICE == 0
    net_buf_simple_init_with_data(&key_buf, keys[0], KEY_LEN);
    err = recreate_key(ADVERTISER_KEY_ID, key_buf);

    if (err != PSA_SUCCESS)
        goto ret_fail;
    printk("Flashed key 0\n");

    for (size_t i = 1; i < ARRAY_SIZE(keys); i++) {
        net_buf_simple_init_with_data(&key_buf, keys[i], MAC_LEN);
        err = recreate_key(MIN_SCANNER_KEY_ID + i - 1, key_buf);

        if (err != PSA_SUCCESS)
            goto ret_fail;
        printk("Flashed key %d\n", i);
    }
#else  // advertiser part
    net_buf_simple_init_with_data(&key_buf, keys[0], MAC_LEN);
    err = recreate_key(ADVERTISER_KEY_ID, key_buf);
    if (err != PSA_SUCCESS)
        goto ret_fail;

    net_buf_simple_init_with_data(
        &key_buf, keys[CONFIG_FLASHED_DEVICE], MAC_LEN);
    err = recreate_key(MIN_SCANNER_KEY_ID, key_buf);
    if (err != PSA_SUCCESS)
        goto ret_fail;
#endif // scanner part

    printk("Finished flashing device with id %d\n",
           CONFIG_FLASHED_DEVICE);
    k_sleep(K_FOREVER);

ret_fail:
    printk("Failed to flash crypto key, (err: %d)", err);
ret:
    k_sleep(K_FOREVER);
}
```
