## Kconfig
```kconfig
# Copyright (c) 2021 Nordic Semiconductor ASA
# SPDX-License-Identifier: Apache-2.0
#
# This Kconfig file is picked by the Zephyr build system because it is defined
# as the module Kconfig entry point (see zephyr/module.yml). You can browse
# module options by going to Zephyr -> Modules in Kconfig.

rsource "drivers/Kconfig"
rsource "lib/Kconfig"


config BLOCK_TIME
    int "Time in seconds each block should take"
    default 10
    help
        For reference with 2020 article related to PAwR this was the time
        interval at which the data was updated.

config ADVERTISER_KEY_ID_OFFSET
    int "ID of the advertiser key in PSA crypto"
    default 0

config SCANNER_MIN_KEY_ID
    int "ID of 1'st scanner"
    default 2
    help
        ID of 1'st scanner, where other scanners will
        have consecutive Id's.
```

## lib/Kconfig
```kconfig
# Copyright (c) 2021 Legrand North America, LLC.
# SPDX-License-Identifier: Apache-2.0

menu "Custom libraries"

rsource "interactive/Kconfig"
rsource "data_generator/Kconfig"

endmenu
```

## lib/data_generator/Kconfig
```kconfig
config DATA_GENERATOR
	bool "Support for data_generator lib"
	help
        Enables data_generator lib
```

## lib/interactive/Kconfig
```kconfig
# Copyright (c) 2021, Legrand North America, LLC.
# SPDX-License-Identifier: Apache-2.0

config INTERACTIVE
	bool "Support for interactive lib"
    depends on !CONFIG_ARCH_POSIX
	help
        Enables interactive lib
```
